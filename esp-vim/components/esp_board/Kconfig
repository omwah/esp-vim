## esp-vim/components/esp_power/Kconfig
```kconfig
menu "esp-vim power"

    config ESP_VIM_WAKE_KEY_GPIO
        int "Wake button GPIO (-1: none)"
        default -1
        range -1 48
        help
            A button, pulled up and pressed to ground, that wakes the board
            from sleep -- and, pressed while it's awake, puts it into reader
            mode. With one, sleep is light sleep: Vim carries on exactly where
            it was. To wake from deep sleep as well it must be an RTC GPIO
            (0-21 on the ESP32-S3). The Waveshare ESP32-S3-RLCD-4.2's KEY is 18.

    config ESP_VIM_BAT_ADC_GPIO
        int "Battery voltage ADC GPIO (-1: none)"
        default -1
        range -1 48
        help
            Where the battery's voltage can be read, through a divider. With
            one (and the console on the S3's own USB, which tells when a
            computer is there), the board knows when it's on battery, and only
            then sleeps by itself. The RLCD-4.2's is 4.

    config ESP_VIM_BAT_DIVIDER
        int "Battery divider: battery mV per 1000 mV at the pin"
        default 3000
        help
            The RLCD-4.2 reads the battery through 200k over 100k: 3000.

    config ESP_VIM_SLEEP_IDLE_MIN
        int "Minutes without a key, on battery, before reader mode (0: never)"
        default 0
        help
            The default; :EspPower idle changes it, kept in NVS.

    config ESP_VIM_SLEEP_DEEP_MIN
        int "Minutes in reader mode before deep sleep (0: never)"
        default 60
        help
            Only when no buffer has unsaved changes. The default; :EspPower
            deep changes it, kept in NVS.

    config ESP_VIM_SLEEP_LOW_MV
        int "Battery mV below which the board goes to deep sleep (0: never)"
        default 3450
        help
            Only on battery, and when no buffer has unsaved changes.

endmenu
```

## esp-vim/components/esp_sd/Kconfig
```kconfig
menu "esp-vim SD card"

    choice ESP_VIM_SD
        prompt "SD card slot"
        default ESP_VIM_SD_NONE
        help
            The board's microSD slot, mounted at /sd (FAT or exFAT; a card
            is never formatted). SPI is the common wiring on small boards;
            SDMMC (4 data lines) is faster where the board has it.

    config ESP_VIM_SD_NONE
        bool "none"
    config ESP_VIM_SD_SPI
        bool "SPI"
    config ESP_VIM_SD_SDMMC
        bool "SDMMC, 4-bit"
        depends on SOC_SDMMC_HOST_SUPPORTED
    endchoice

    config ESP_VIM_SD
        bool
        default y if !ESP_VIM_SD_NONE

    config ESP_VIM_SD_MHZ
        int "Clock (MHz)"
        depends on ESP_VIM_SD
        range 1 40
        default 20
        help
            The card clock: 20 MHz is SPI's default; SDMMC cards run to 40
            (high speed). A long or noisy wiring may need less.

    config ESP_VIM_SD_SPI_SCLK
        int "SCLK GPIO"
        depends on ESP_VIM_SD_SPI
        default 12
    config ESP_VIM_SD_SPI_MOSI
        int "MOSI GPIO"
        depends on ESP_VIM_SD_SPI
        default 11
    config ESP_VIM_SD_SPI_MISO
        int "MISO GPIO"
        depends on ESP_VIM_SD_SPI
        default 13
    config ESP_VIM_SD_SPI_CS
        int "CS GPIO"
        depends on ESP_VIM_SD_SPI
        default 10

    config ESP_VIM_SD_MMC_SLOT
        int "SDMMC slot"
        depends on ESP_VIM_SD_SDMMC
        range 0 1
        default 1
        help
            The host controller's slot. On the ESP32-P4, slot 0 is the one
            on fixed pins (CLK 43, CMD 44, D0-D3 39-42) and slot 1 is routed
            through the GPIO matrix -- on the Tab5, the ESP32-C6's SDIO link
            has slot 1, and the card slot 0. On the ESP32-S3 either will do.

    config ESP_VIM_SD_LDO_CHAN
        int "On-chip LDO channel powering the card (-1: none)"
        depends on ESP_VIM_SD_SDMMC
        default -1
        help
            ESP32-P4 boards may power the card's slot from one of the chip's
            own LDOs; the Tab5's is channel 4.

    config ESP_VIM_SD_MMC_CLK
        int "CLK GPIO"
        depends on ESP_VIM_SD_SDMMC
        default 38
    config ESP_VIM_SD_MMC_CMD
        int "CMD GPIO"
        depends on ESP_VIM_SD_SDMMC
        default 40
    config ESP_VIM_SD_MMC_D0
        int "D0 GPIO"
        depends on ESP_VIM_SD_SDMMC
        default 39
    config ESP_VIM_SD_MMC_D1
        int "D1 GPIO"
        depends on ESP_VIM_SD_SDMMC
        default 41
    config ESP_VIM_SD_MMC_D2
        int "D2 GPIO"
        depends on ESP_VIM_SD_SDMMC
        default 48
    config ESP_VIM_SD_MMC_D3
        int "D3 GPIO"
        depends on ESP_VIM_SD_SDMMC
        default 47

endmenu
```

## esp-vim/components/esp_time/Kconfig
```kconfig
menu "esp-vim time"

    choice ESP_VIM_RTC
        prompt "RTC chip"
        default ESP_VIM_RTC_NONE
        help
            A battery-backed clock that keeps the time while the board is
            off. On the I2C bus of :EspI2cScan (ESP_VIM_I2C_SDA/SCL).
    config ESP_VIM_RTC_NONE
        bool "None"
    config ESP_VIM_RTC_PCF85063
        bool "PCF85063 (0x51; the Waveshare ESP32-S3-RLCD-4.2's)"
    endchoice

    config ESP_VIM_NTP_SERVER
        string "NTP server"
        default "pool.ntp.org"
        help
            The default; :EspTime server changes it, kept in NVS.

    config ESP_VIM_TZ
        string "Time zone"
        default "UTC"
        help
            A name (US/Pacific, Europe/Paris, ...) or a POSIX TZ string
            (PST8PDT,M3.2.0,M11.1.0). The default; :EspTime tz changes it.

endmenu
```

## esp-vim/components/esp_touch/Kconfig
```kconfig
menu "esp-vim touch"

    config ESP_VIM_TOUCH
        bool "Capacitive touch panel on I2C"
        default n
        help
            Touches become mouse events in Vim (tap, drag, swipe to scroll)
            and drive the Bluetooth pairing overlay. The FT6336G defaults
            below are the Hosyond ES3C28P's (docs/PLAN.md, 10b); the GT911
            ones the Freenove FNK0115's.

    if ESP_VIM_TOUCH

    choice ESP_VIM_TOUCH_CHIP
        prompt "Controller"
        default ESP_VIM_TOUCH_FT6336
    config ESP_VIM_TOUCH_FT6336
        bool "FT6336G / FT6x06"
    config ESP_VIM_TOUCH_GT911
        bool "GT911"
    config ESP_VIM_TOUCH_BOARD
        bool "The board's own (esp_board: M5Stack Tab5)"
        depends on ESP_VIM_BOARD_TAB5
        help
            Whichever controller goes with the fitted panel (GT911, or the
            ST7123/ST7121's own), through Espressif's board support package,
            polled. Its points are turned the way the display turns the
            picture (ESP_VIM_DISP_ROTATION); the pins, address and
            swap/mirror settings below don't apply.
    endchoice

    config ESP_VIM_TOUCH_SDA
        int "SDA GPIO"
        default 19 if ESP_VIM_TOUCH_GT911
        default 16
    config ESP_VIM_TOUCH_SCL
        int "SCL GPIO"
        default 20 if ESP_VIM_TOUCH_GT911
        default 15
    config ESP_VIM_TOUCH_INT
        int "Interrupt GPIO"
        default 18 if ESP_VIM_TOUCH_GT911
        default 17
    config ESP_VIM_TOUCH_RST
        int "Reset GPIO (active low; -1: none)"
        default 38 if ESP_VIM_TOUCH_GT911
        default 18
    config ESP_VIM_TOUCH_ADDR
        hex "I2C address"
        default 0x5D if ESP_VIM_TOUCH_GT911
        default 0x38
        help
            A GT911 takes 0x5D or 0x14, chosen by its INT line at reset;
            with a reset pin, the driver selects the one given here.
            Without one (-1), this is tried first and then the other.

    config ESP_VIM_TOUCH_ANY_EDGE
        bool "Wake on either edge of INT"
        depends on !ESP_VIM_TOUCH_BOARD
        default n
        help
            For a GT911 whose INT mode isn't known: pulses either way, or a
            level held while touched (the LilyGo T-Deck Plus's differ from
            unit to unit). Off, a falling edge wakes the touch task.

    config ESP_VIM_TOUCH_GT911_SWITCH_REF
        int "GT911 Module_Switch1 the swap and mirrors are right for (-1: ignore it)"
        depends on ESP_VIM_TOUCH_GT911
        range -1 255
        default -1
        help
            A GT911's own configuration can reverse its axes and swap them
            (register 0x804D: bit 7 Driver_Reversal, bit 6 Sensor_Reversal,
            bit 3 X2Y), and panels of one board can differ there: the LilyGo
            T-Deck Plus's left and right from batch to batch. Set this to
            the value (the boot log shows it) on a panel the swap and mirrors
            below are right for; a panel whose bits differ gets those axes
            turned back. :EspTouch sets a turn of its own over all this.

    config ESP_VIM_TOUCH_WIDTH
        int "Screen width, as mounted"
        default 1280 if ESP_VIM_TOUCH_BOARD
        default 800 if ESP_VIM_TOUCH_GT911
        default 320
    config ESP_VIM_TOUCH_HEIGHT
        int "Screen height, as mounted"
        default 720 if ESP_VIM_TOUCH_BOARD
        default 480 if ESP_VIM_TOUCH_GT911
        default 240

    # The panel reports portrait coordinates. The ES3C28P, landscape with the
    # USB port on the right (as esp_display draws it): swap, then mirror X.
    config ESP_VIM_TOUCH_SWAP_XY
        bool "Swap X and Y"
        default n if ESP_VIM_TOUCH_GT911 || ESP_VIM_TOUCH_BOARD
        default y
    config ESP_VIM_TOUCH_MIRROR_X
        bool "Mirror X (after swapping)"
        default n if ESP_VIM_TOUCH_GT911 || ESP_VIM_TOUCH_BOARD
        default y
    config ESP_VIM_TOUCH_MIRROR_Y
        bool "Mirror Y (after swapping)"
        default n

    endif

endmenu
```

## esp-vim/components/esp_usbkbd/Kconfig
```kconfig
menu "esp-vim USB keyboards"

    config ESP_VIM_USB_KBD
        bool "USB keyboards (USB host)"
        depends on SOC_USB_OTG_SUPPORTED
        default n
        help
            Keyboards on the chip's USB host port -- the Tab5's USB-A --
            typed as Bluetooth ones are (components/esp_kbd). Boot-protocol
            keyboards are asked for their boot reports; others are read
            through their report descriptors. Hubs and several keyboards at
            once work as the USB Host Library allows.

endmenu
```

## esp-vim/components/micropython/Kconfig
```kconfig
menu "esp-vim: MicroPython"

    config ESP_VIM_PY_HEAP_KB
        int "Python heap (KB)"
        range 64 16384
        default 4096 if IDF_TARGET_ESP32P4
        default 1024
        help
            The MicroPython heap: one block, from PSRAM when there is some,
            allocated the first time Python runs (:EspPy, :EspPyRun) and kept.
            A script cannot use more; the editor's own memory is separate.

endmenu
```
