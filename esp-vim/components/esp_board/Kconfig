## esp-vim/components/esp_board/Kconfig
```kconfig
menu "esp-vim board layer"

    config ESP_VIM_BOARD_TAB5
        bool "M5Stack Tab5"
        depends on IDF_TARGET_ESP32P4
        default n
        help
            The Tab5's own hardware, through Espressif's board support
            package (m5stack_tab5_noglib): the internal I2C bus (GPIO31/32)
            and its two PI4IOE5V6408 IO expanders, which switch the ESP32-C6's
            power, the USB-A port's 5 V, the LCD, touch and speaker; and the
            MIPI-DSI panel, whichever of the three fitted revisions it is
            (ILI9881C + GT911, ST7123, ST7121).

endmenu
```

## esp-vim/components/esp_display/Kconfig
```kconfig
menu "esp-vim display"

    config ESP_VIM_DISPLAY
        bool "Show the console on an LCD"
        default n
        help
            Mirror the console to a panel: Vim's output is drawn with a
            bitmap font (Spleen), and input still comes from the console.
            The SPI defaults below are the Hosyond ES3C28P's (docs/PLAN.md,
            10b), or with the ST7305 the Waveshare ESP32-S3-RLCD-4.2's; the
            RGB ones the Freenove FNK0115's.

    if ESP_VIM_DISPLAY

    choice ESP_VIM_DISP_BUS
        prompt "Panel"
        default ESP_VIM_DISP_ILI9341
    config ESP_VIM_DISP_ILI9341
        bool "ILI9341 on SPI"
    config ESP_VIM_DISP_RGB
        bool "RGB parallel panel (16-bit RGB565, frame buffer in PSRAM)"
        depends on SOC_LCD_RGB_SUPPORTED && SPIRAM
    config ESP_VIM_DISP_ST7305
        bool "ST7305 reflective monochrome LCD on SPI (1 bit per pixel)"
        help
            Black on white: reverse video and cells with a background
            colour are drawn inverted, bold is drawn a pixel heavier.
    config ESP_VIM_DISP_DSI
        bool "The board's MIPI-DSI panel (esp_board: M5Stack Tab5)"
        depends on ESP_VIM_BOARD_TAB5
        help
            Set up by the board layer, whichever panel revision is fitted.
            Cells are drawn straight into its frame buffer in PSRAM, turned
            by ESP_VIM_DISP_ROTATION; the backlight is the board's.
    endchoice

    config ESP_VIM_DISP_ROTATION
        int "Picture turned on the panel, clockwise (0, 90, 180, 270)"
        depends on ESP_VIM_DISP_DSI
        default 270
        help
            The Tab5's panel is portrait, 720 x 1280; 90 or 270 gives Vim a
            landscape screen. 270 is the right way up on the first Tab5
            (ST7121 panel); 90 showed it upside down.
            :EspFlip turns it over at run time (kept in NVS), and the touch
            controller follows either way.

    config ESP_VIM_DISP_FONTS
        string "Fonts"
        default "terminus-12x24 terminus-10x20 terminus-16x32 spleen-8x16" if ESP_VIM_DISP_DSI
        default "terminus-10x20 terminus-11x22 spleen-8x16" if ESP_VIM_DISP_RGB
        default "spleen-6x12 spleen-5x8 terminus-8x14 spleen-8x16" if ESP_VIM_DISP_ST7305
        default "spleen-6x12"
        help
            The terminal's fonts, separated by spaces; :EspFont switches
            between them, and the choice is kept in NVS. The first is the
            default. Each is spleen-WxH (5x8, 6x12, 8x16, 12x24, 16x32) or
            terminus-WxH / terminus-bold-WxH (6x12, 8x14, 8x16, 10x18, 10x20,
            11x22, 12x24, 14x28, 16x32). On the 800x480 panel, 10x20 is 80x24
            cells, 11x22 72x21 and 8x16 100x30; on the 400x300 ST7305, 6x12
            is 66x25; on the Tab5's 1280x720, 12x24 is 106x30, 10x20 128x36,
            16x32 80x22 and 8x16 160x45. Each font's glyphs take
            flash: about 20 KB for Spleen 8x16, 60 KB for Terminus 10x20 --
            and as much PSRAM, where the program runs from a copy there.

    choice ESP_VIM_DISP_OVERLAY_FONT
        prompt "Overlay font (the Bluetooth pairing screen)"
        default ESP_VIM_DISP_OVERLAY_16X32 if ESP_VIM_DISP_RGB || ESP_VIM_DISP_DSI
        default ESP_VIM_DISP_OVERLAY_12X24
    config ESP_VIM_DISP_OVERLAY_12X24
        bool "Spleen 12x24"
    config ESP_VIM_DISP_OVERLAY_16X32
        bool "Spleen 16x32"
    endchoice

    config ESP_VIM_DISP_WIDTH
        int "Width in pixels, as mounted"
        default 1280 if ESP_VIM_DISP_DSI
        default 800 if ESP_VIM_DISP_RGB
        default 400 if ESP_VIM_DISP_ST7305
        default 320

    config ESP_VIM_DISP_HEIGHT
        int "Height in pixels, as mounted"
        default 720 if ESP_VIM_DISP_DSI
        default 480 if ESP_VIM_DISP_RGB
        default 300 if ESP_VIM_DISP_ST7305
        default 240

    config ESP_VIM_DISP_BACKLIGHT
        int "Backlight GPIO (-1: none, or the board's)"
        default 2 if ESP_VIM_DISP_RGB
        default -1 if ESP_VIM_DISP_ST7305 || ESP_VIM_DISP_DSI
        default 45
    config ESP_VIM_DISP_BACKLIGHT_ON_LEVEL
        int "Backlight on level"
        default 1

    if ESP_VIM_DISP_ILI9341 || ESP_VIM_DISP_ST7305

    config ESP_VIM_DISP_SPI_MHZ
        int "SPI clock, MHz"
        default 10 if ESP_VIM_DISP_ST7305
        default 60
        help
            The ES3C28P drops bytes at 80 MHz.

    config ESP_VIM_DISP_SCLK
        int "SCLK GPIO"
        default 11 if ESP_VIM_DISP_ST7305
        default 12
    config ESP_VIM_DISP_MOSI
        int "MOSI GPIO"
        default 12 if ESP_VIM_DISP_ST7305
        default 11
    config ESP_VIM_DISP_CS
        int "CS GPIO"
        default 40 if ESP_VIM_DISP_ST7305
        default 10
    config ESP_VIM_DISP_DC
        int "DC GPIO"
        default 5 if ESP_VIM_DISP_ST7305
        default 46
    config ESP_VIM_DISP_RST
        int "Reset GPIO (-1: none, software reset)"
        default 41 if ESP_VIM_DISP_ST7305
        default -1
    # The ES3C28P, landscape with the USB port on the right: swapped and
    # mirrored both ways (without the mirrors it's upside down).
    config ESP_VIM_DISP_MIRROR_X
        bool "Mirror X"
        default n if ESP_VIM_DISP_ST7305
        default y
    config ESP_VIM_DISP_MIRROR_Y
        bool "Mirror Y"
        default n if ESP_VIM_DISP_ST7305
        default y

    endif

    if ESP_VIM_DISP_ILI9341

    config ESP_VIM_DISP_INVERT
        bool "Invert colours (IPS panels that show complements)"
        default y
    config ESP_VIM_DISP_SWAP_XY
        bool "Swap X and Y (landscape)"
        default y
    config ESP_VIM_DISP_BGR
        bool "Panel is BGR"
        default y

    endif # ESP_VIM_DISP_ILI9341

    if ESP_VIM_DISP_RGB

    config ESP_VIM_DISP_PCLK_HZ
        int "Pixel clock, Hz"
        default 13000000
    config ESP_VIM_DISP_PCLK_ACTIVE_NEG
        bool "Data changes on the falling edge of the pixel clock"
        default y
    config ESP_VIM_DISP_HSYNC_PULSE
        int "HSYNC pulse width"
        default 4
    config ESP_VIM_DISP_HSYNC_BACK
        int "HSYNC back porch"
        default 8
    config ESP_VIM_DISP_HSYNC_FRONT
        int "HSYNC front porch"
        default 4
    config ESP_VIM_DISP_VSYNC_PULSE
        int "VSYNC pulse width"
        default 4
    config ESP_VIM_DISP_VSYNC_BACK
        int "VSYNC back porch"
        default 8
    config ESP_VIM_DISP_VSYNC_FRONT
        int "VSYNC front porch"
        default 4

    config ESP_VIM_DISP_DE
        int "DE GPIO"
        default 40
    config ESP_VIM_DISP_VSYNC
        int "VSYNC GPIO"
        default 41
    config ESP_VIM_DISP_HSYNC
        int "HSYNC GPIO"
        default 39
    config ESP_VIM_DISP_PCLK
        int "PCLK GPIO"
        default 42
    config ESP_VIM_DISP_DATA
        string "Data GPIOs D0..D15: B0-B4, G0-G5, R0-R4"
        default "8,3,46,9,1,5,6,7,15,16,4,45,48,47,21,14"

    config ESP_VIM_DISP_BOUNCE_LINES
        int "Bounce buffer, in lines (0: none)"
        default 0
        help
            Lines of internal RAM the LCD streams through, twice over,
            instead of reading the frame buffer in PSRAM directly: steadier
            when flash is written, at 2 x lines x width x 2 bytes of
            internal RAM.

    endif # ESP_VIM_DISP_RGB

    endif

endmenu
```

## esp-vim/components/esp_git/Kconfig
```kconfig
menu "esp-vim git"

    config ESP_VIM_GIT_SELFTEST
        bool "libgit2 feasibility self-test (stage 6z)"
        default n
        help
            Links libgit2 and starts a task that waits for /fat/gittest.conf,
            then runs init, commit, status, clone, fetch and push against the
            URLs in it and prints the results (GIT-ST lines) with time, heap
            and stack figures. Driven by esp-vim/test/git.py. Not for use:
            it decides how Phase 8 is built (docs/PLAN.md).

    config ESP_VIM_GIT_SELFTEST_STACK
        int "Self-test task stack (bytes)"
        depends on ESP_VIM_GIT_SELFTEST
        default 32768

endmenu
```

## esp-vim/components/esp_kbd/Kconfig
```kconfig
menu "esp-vim keyboards"

    config ESP_VIM_KBD_TAB5
        bool "M5Stack Tab5 keyboard accessory (I2C 0x6D)"
        default n
        help
            The Tab5's clip-on keyboard: an STM32 on Ext.Port1, read in its
            "normal" mode (each key's row and column) on its interrupt line,
            and typed as esp_kbd_tab5.h describes -- Sym for the second
            legends, F1-F12 and PgUp/Home/PgDn/End. Found when attached,
            also after boot. Its two LEDs show Sym, Aa (and Caps Lock),
            Ctrl and Alt.

    config ESP_VIM_KBD_TAB5_SDA
        int "SDA GPIO"
        depends on ESP_VIM_KBD_TAB5
        default 0
    config ESP_VIM_KBD_TAB5_SCL
        int "SCL GPIO"
        depends on ESP_VIM_KBD_TAB5
        default 1
    config ESP_VIM_KBD_TAB5_INT
        int "Interrupt GPIO"
        depends on ESP_VIM_KBD_TAB5
        default 50

    config ESP_VIM_KBD_CARDPUTER
        bool "M5Stack Cardputer ADV keyboard (TCA8418, I2C 0x34)"
        default n
        help
            The Cardputer ADV's built-in 56 keys, behind a TCA8418 key-scan
            controller, typed as esp_kbd_cardputer.h describes: ` is Esc,
            Fn for F1-F12, the arrows, Delete, PgUp and PgDn, and sticky
            modifiers. (The original Cardputer's keyboard is a GPIO matrix,
            not this.)

    config ESP_VIM_KBD_CARDPUTER_SDA
        int "SDA GPIO"
        depends on ESP_VIM_KBD_CARDPUTER
        default 8
    config ESP_VIM_KBD_CARDPUTER_SCL
        int "SCL GPIO"
        depends on ESP_VIM_KBD_CARDPUTER
        default 9
    config ESP_VIM_KBD_CARDPUTER_INT
        int "Interrupt GPIO"
        depends on ESP_VIM_KBD_CARDPUTER
        default 11

    config ESP_VIM_KBD_TDECK
        bool "LilyGo T-Deck / T-Deck Plus keyboard and trackball"
        default n
        help
            The T-Deck's built-in 35 keys, scanned by an ESP32-C3 on the
            board's I2C bus, typed as esp_kbd_tdeck.h describes: Mic is Ctrl,
            Alt is Esc, Sym the printed second legends, Sym with Shift the
            rest, and sticky modifiers. Esc, Ctrl and the Sym layers need the
            C3's raw mode (LilyGo's keyboard firmware of June 2025 or later);
            older firmware types characters only. The trackball rolls as
            arrow keys, and the keys light up while you type.

    if ESP_VIM_KBD_TDECK

    config ESP_VIM_KBD_TDECK_SDA
        int "SDA GPIO"
        default 18
    config ESP_VIM_KBD_TDECK_SCL
        int "SCL GPIO"
        default 8
    config ESP_VIM_KBD_TDECK_ADDR
        hex "The keyboard's I2C address"
        default 0x55

    config ESP_VIM_KBD_TDECK_LIGHT_SEC
        int "Key backlight: seconds on after a key (0: off)"
        range 0 65535
        default 10
        help
            The keys light up while you type, and go dark this long after
            the last key. :EspKeyLight changes it, kept in NVS.
    config ESP_VIM_KBD_TDECK_LIGHT_LEVEL
        int "Key backlight brightness (1-255)"
        range 1 255
        default 127

    config ESP_VIM_KBD_TDECK_BALL_UP
        int "Trackball up GPIO"
        default 3
    config ESP_VIM_KBD_TDECK_BALL_DOWN
        int "Trackball down GPIO"
        default 15
    config ESP_VIM_KBD_TDECK_BALL_LEFT
        int "Trackball left GPIO"
        default 1
    config ESP_VIM_KBD_TDECK_BALL_RIGHT
        int "Trackball right GPIO"
        default 2
    config ESP_VIM_KBD_TDECK_BALL_STEP
        int "Trackball toggles per arrow key"
        range 1 16
        default 2
        help
            Each of the trackball's sensors toggles its pin as the ball
            rolls; this many toggles one way is one arrow key. More is
            slower.

    endif

endmenu
```

## esp-vim/components/esp_net/Kconfig
```kconfig
menu "esp-vim network"

    choice ESP_VIM_NET
        prompt "Network interface"
        default ESP_VIM_NET_WIFI if SOC_WIFI_SUPPORTED
        default ESP_VIM_NET_ETH if SOC_EMAC_SUPPORTED
        default ESP_VIM_NET_NONE
        help
            How the device reaches the network: WiFi (native on the ESP32-S3,
            through a radio co-processor on the ESP32-P4), Ethernet, or none.

        config ESP_VIM_NET_NONE
            bool "None"

        config ESP_VIM_NET_WIFI
            bool "WiFi (the chip's own radio)"
            depends on SOC_WIFI_SUPPORTED
            help
                Station mode. :EspWifiConnect stores the network in NVS and the
                device reconnects at every boot. esp-emu provides a soft AP
                (myssid / mypassword) for testing.

        config ESP_VIM_NET_WIFI_REMOTE
            bool "WiFi through an ESP32-C6 co-processor (esp-hosted, SDIO)"
            depends on !SOC_WIFI_SUPPORTED
            help
                The M5Stack Tab5's arrangement: the P4 has no radio, and
                esp_wifi_remote carries the ordinary esp_wifi_* API over SDIO
                to an ESP32-C6 running esp-hosted's co-processor firmware
                (scripts/c6-build.sh). Same behaviour as native WiFi. Brings in
                the esp_hosted and esp_wifi_remote components.

        config ESP_VIM_NET_ETH
            bool "Ethernet (internal EMAC, generic IEEE 802.3 PHY)"
            depends on SOC_EMAC_SUPPORTED
            help
                The ESP32-P4's EMAC. This is also what esp-emu models, so the
                P4 build has networking in the emulator (--net user). A board
                with no Ethernet PHY simply never gets a link.
    endchoice

    config ESP_VIM_WIFI
        bool
        default y if ESP_VIM_NET_WIFI || ESP_VIM_NET_WIFI_REMOTE

endmenu
```
